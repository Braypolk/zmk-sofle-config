## config/west.yml
```yaml
# manifest:
#   remotes:
#     - name: zmkfirmware
#       url-base: https://github.com/zmkfirmware
#     - name: split-encoder
#       url-base: https://github.com/petejohanson
#   projects:
#     - name: zmk
#       remote: split-encoder
#       revision: stephen/split-encoder
#       import: app/west.yml
#   self:
#     path: config
manifest:
  remotes:
    - name: zmkfirmware
      url-base: https://github.com/zmkfirmware
    - name: infused-kim
      url-base: https://github.com/infused-kim
  projects:
    - name: zmk
      remote: infused-kim
      revision: sofle
      import: app/west.yml
  self:
    path: config
```
